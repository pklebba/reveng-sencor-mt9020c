/*
 * Sencor MT9020C — ESP32 IR transmitter + HTTP control
 *
 * Builds the verified 112-bit IR frame on the MCU (a C++ port of
 * tools/encode.py) and transmits it via an IR LED, exposing a tiny HTTP API
 * so the air conditioner can be controlled over WiFi.
 *
 * The carrier is generated by the ESP32 **RMT** peripheral (hardware), not a
 * software bit-bang. On the ESP32-C6 a bit-banged carrier comes out at the
 * wrong frequency and is shredded by WiFi interrupts; RMT is exact and
 * interrupt-immune.
 *
 * Protocol: see ../../docs/protocol.md (LSB-first, PDM, ~38 kHz carrier,
 * checksum = sum(bytes 0..12) mod 256).
 *
 * Build: PlatformIO (see ../platformio.ini). No external libraries — RMT comes
 * from the Arduino-ESP32 core.
 *
 * Wiring (IR LED driven through an NPN transistor, NOT straight off GPIO):
 *     GPIO4 --[330R]--> base (2N2222 / BC337)
 *     3V3   --[22R]---> IR LED anode; LED cathode -> collector; emitter -> GND
 * For a quick bench test the LED may sit directly on GPIO4 via ~100R, a few
 * cm from the AC's receiver window.
 *
 * HTTP API (GET):
 *     /ac?power=on&mode=cool&temp=22&fan=auto&swing=0&unit=c&khz=38
 *     /off
 * Params are optional; defaults below are used when omitted.
 */
#include <Arduino.h>
#include <WiFi.h>
#include <WebServer.h>
#include "secrets.h"               // WIFI_SSID / WIFI_PASS (gitignored)

// ---- User configuration --------------------------------------------------
const uint16_t IR_LED_PIN = 4;     // GPIO driving the IR LED / transistor base
const uint16_t IR_RX_PIN  = 5;     // TSOP receiver OUT (demodulated envelope)
uint16_t carrierKhz = 38;          // IR carrier; tune live via /ac?khz=36 (36..40)

// ---- Protocol constants (from docs/protocol.md) --------------------------
enum Mode : uint8_t { MODE_HEAT = 0x01, MODE_DRY = 0x02, MODE_COOL = 0x03,
                      MODE_FAN = 0x07, MODE_HOLD = 0x08 };
enum Fan  : uint8_t { FAN_AUTO = 0x00, FAN_SLEEP = 0x01, FAN_LOW = 0x02,
                      FAN_MED = 0x03, FAN_HIGH = 0x05 };

static const uint16_t LEADER_MARK = 3150, LEADER_SPACE = 1575;
static const uint16_t BIT_MARK = 500, SPACE_0 = 345, SPACE_1 = 1160;
static const uint8_t SWING_BITS = 0x38;
static const uint8_t UNIT_F = 0xC9;

// Envelope: leader(2) + 112 bits * 2 + stop mark(1) = 227 (level, duration)
// entries, packed two-per-symbol into 114 RMT symbols.
static const int N_ENTRIES = 2 + 112 * 2 + 1;
static const int N_SYMBOLS = (N_ENTRIES + 1) / 2;

WebServer server(80);

rmt_data_t rxBuf[512];             // big enough for a noisy frame's symbols
size_t rxNum;
String lastRx = "none";
const uint32_t RX_DEBOUNCE_US = 100;  // glitch filter (legit min pulse ~345 us)

// ---- Frame construction (mirror of tools/encode.py) ----------------------
void buildFrame(uint8_t out[14], bool power, uint8_t mode, int temp,
                uint8_t fan, bool swing, bool unitF) {
  const uint8_t header[5] = {0x23, 0xCB, 0x26, 0x01, 0x00};
  for (int i = 0; i < 5; i++) out[i] = header[i];
  for (int i = 5; i < 14; i++) out[i] = 0;

  out[5] = 0x20 | (power ? 0x04 : 0x00);            // power, bit 2 = on
  out[6] = mode;

  // temperature: base - T; 32 C (Cool-like) handled by the byte-11 flag.
  int base = (mode == MODE_HEAT) ? 26 : 31;
  if (mode == MODE_HEAT) temp = constrain(temp, 13, 26);
  else                   temp = constrain(temp, 16, 32);
  bool flag32 = (mode != MODE_HEAT && temp >= 32);
  out[7] = flag32 ? 0 : (uint8_t)((base - temp) & 0xFF);
  out[11] = flag32 ? 0x01 : 0x00;

  out[8] = fan | (swing ? SWING_BITS : 0);
  out[12] = unitF ? UNIT_F : 0x00;

  uint16_t sum = 0;
  for (int i = 0; i < 13; i++) sum += out[i];
  out[13] = sum & 0xFF;                              // checksum
}

// ---- IR transmit via RMT (hardware carrier) ------------------------------
void irSetup() {
  rmtInit(IR_LED_PIN, RMT_TX_MODE, RMT_MEM_NUM_BLOCKS_1, 1000000);  // 1 us/tick
  rmtSetCarrier(IR_LED_PIN, true, false, carrierKhz * 1000, 0.5);  // carrier on HIGH (marks), 50% duty
}

// Sends the frame and returns its 14 bytes as a "23 CB 26 ..." hex string.
String sendAC(bool power, uint8_t mode, int temp, uint8_t fan,
              bool swing, bool unitF) {
  uint8_t frame[14];
  buildFrame(frame, power, mode, temp, fan, swing, unitF);

  // Flat envelope: HIGH = carrier-on mark, LOW = space. Bits are LSB-first.
  uint16_t dur[N_ENTRIES];
  uint8_t lvl[N_ENTRIES];
  int n = 0;
  dur[n] = LEADER_MARK;  lvl[n++] = 1;
  dur[n] = LEADER_SPACE; lvl[n++] = 0;
  for (int i = 0; i < 14; i++)
    for (int j = 0; j < 8; j++) {
      dur[n] = BIT_MARK; lvl[n++] = 1;
      dur[n] = ((frame[i] >> j) & 1) ? SPACE_1 : SPACE_0; lvl[n++] = 0;
    }
  dur[n] = BIT_MARK; lvl[n++] = 1;                  // trailing stop mark

  rmt_data_t sym[N_SYMBOLS];
  int ns = 0;
  for (int k = 0; k < n; k += 2) {
    sym[ns].duration0 = dur[k];   sym[ns].level0 = lvl[k];
    sym[ns].duration1 = (k + 1 < n) ? dur[k + 1] : 0;
    sym[ns].level1    = (k + 1 < n) ? lvl[k + 1] : 0;
    ns++;
  }

  rmtSetCarrier(IR_LED_PIN, true, false, carrierKhz * 1000, 0.5);  // carrier on HIGH (marks), 50% duty
  rmtWrite(IR_LED_PIN, sym, ns, RMT_WAIT_FOR_EVER);

  char hex[3 * 14];
  for (int i = 0; i < 14; i++) snprintf(hex + i * 3, 4, "%02X ", frame[i]);
  hex[3 * 14 - 1] = '\0';                            // trim trailing space

  Serial.printf("TX frame: %s\n", hex);
  return String(hex);
}

// ---- IR receive + on-device decode (mirror of tools/decode.py) -----------
const char *modeName(uint8_t m) {
  switch (m) {
    case MODE_HEAT: return "Heat"; case MODE_DRY: return "Dry";
    case MODE_COOL: return "Cool"; case MODE_FAN: return "Fan";
    case MODE_HOLD: return "Hold"; default: return "?";
  }
}
const char *fanName(uint8_t f) {
  switch (f) {
    case FAN_AUTO: return "Auto"; case FAN_SLEEP: return "Sleep";
    case FAN_LOW: return "Low"; case FAN_MED: return "Med";
    case FAN_HIGH: return "High"; default: return "?";
  }
}

String describeFrame(const uint8_t b[14]) {
  char hex[3 * 14];
  for (int i = 0; i < 14; i++) snprintf(hex + i * 3, 4, "%02X ", b[i]);
  hex[3 * 14 - 1] = '\0';

  uint16_t sum = 0;
  for (int i = 0; i < 13; i++) sum += b[i];
  bool chk = ((sum & 0xFF) == b[13]);
  bool power = b[5] & 0x04;
  int base = (b[6] == MODE_HEAT) ? 26 : 31;
  int tc = base - b[7] + ((b[11] & 1) ? 1 : 0);
  bool isF = (b[12] == UNIT_F);
  int td = isF ? (int)round(tc * 9.0 / 5.0 + 32) : tc;

  return String(hex) + "  | " + (power ? "ON" : "OFF") + " " + modeName(b[6]) +
         " " + td + (isF ? "F" : "C") + " fan=" + fanName(b[8] & 0x07) +
         ((b[8] & 0x38) ? " swing" : "") + " chk=" + (chk ? "OK" : "BAD");
}

// Decode one received PDM frame: leader, then per mark the following space
// (>750 us = 1). The mark level is taken from the leader, so TSOP polarity
// doesn't matter. Bytes are LSB-first.
void decodeReceived(rmt_data_t *buf, size_t num) {
  static uint8_t lvl[1100];
  static uint32_t dur[1100];
  if (num == 0) return;                          // ignore empty re-arm events
  int n = 0;
  for (size_t s = 0; s < num && n < 1098; s++) {
    lvl[n] = buf[s].level0; dur[n++] = buf[s].duration0;
    if (buf[s].duration1 == 0) break;
    lvl[n] = buf[s].level1; dur[n++] = buf[s].duration1;
  }
  Serial.printf("RX: %d symbols, %d edges\n  raw:", (int)num, n);
  for (int i = 0; i < n && i < 50; i++)          // dump raw timing for diagnosis
    Serial.printf(" %c%lu", lvl[i] ? 'H' : 'L', (unsigned long)dur[i]);
  Serial.println();

  // glitch filter: merge runs shorter than RX_DEBOUNCE_US into the previous run
  int m = 0;
  for (int k = 0; k < n; k++) {
    if (m > 0 && (dur[k] < RX_DEBOUNCE_US || lvl[k] == lvl[m - 1]))
      dur[m - 1] += dur[k];
    else { lvl[m] = lvl[k]; dur[m] = dur[k]; m++; }
  }
  n = m;

  int L = -1;
  for (int i = 0; i < n; i++) if (dur[i] > 2000) { L = i; break; }
  if (L < 0) { Serial.println("RX: no leader (noise?)"); return; }
  uint8_t mark = lvl[L];
  int i = L + 1;
  if (i < n && lvl[i] != mark) i++;               // skip leader space

  uint8_t bits[112]; int nb = 0;
  while (i + 1 < n && nb < 112) {
    if (lvl[i] == mark) {
      if (lvl[i + 1] != mark) { bits[nb++] = dur[i + 1] > 750 ? 1 : 0; i += 2; }
      else i++;
    } else i++;
  }
  if (nb < 112) {
    Serial.printf("RX incomplete: %d/112 bits (%d symbols)\n", nb, (int)num);
    return;
  }
  uint8_t b[14];
  for (int k = 0; k < 14; k++) {
    uint8_t v = 0;
    for (int j = 0; j < 8; j++) v |= bits[k * 8 + j] << j;
    b[k] = v;
  }
  lastRx = describeFrame(b);
  Serial.println("RX " + lastRx);
}

void rxStart() {
  rxNum = sizeof(rxBuf) / sizeof(rxBuf[0]);
  rmtReadAsync(IR_RX_PIN, rxBuf, &rxNum);
}

void rxSetup() {
  rmtInit(IR_RX_PIN, RMT_RX_MODE, RMT_MEM_NUM_BLOCKS_2, 1000000);  // 1 us/tick
  rmtSetRxMinThreshold(IR_RX_PIN, 3);             // HW glitch filter ~3 us (reg is
                                                  // 8-bit on src clock; >~3 us fails)
  rmtSetRxMaxThreshold(IR_RX_PIN, 5000);          // gap > 5 ms ends a frame
  rxStart();
}

// ---- HTTP handlers -------------------------------------------------------
uint8_t parseMode(const String &s) {
  if (s == "heat") return MODE_HEAT;
  if (s == "dry")  return MODE_DRY;
  if (s == "fan")  return MODE_FAN;
  if (s == "hold") return MODE_HOLD;
  return MODE_COOL;                                  // default
}

uint8_t parseFan(const String &s) {
  if (s == "sleep") return FAN_SLEEP;
  if (s == "low")   return FAN_LOW;
  if (s == "med")   return FAN_MED;
  if (s == "high")  return FAN_HIGH;
  return FAN_AUTO;                                   // default
}

bool argBool(const String &name, bool def) {
  if (!server.hasArg(name)) return def;
  String v = server.arg(name);
  return v == "1" || v == "true" || v == "on" || v == "yes";
}

void handleAC() {
  bool power  = argBool("power", true);
  uint8_t mode = parseMode(server.arg("mode"));
  int temp    = server.hasArg("temp") ? server.arg("temp").toInt() : 23;
  uint8_t fan = parseFan(server.arg("fan"));
  bool swing  = argBool("swing", false);
  bool unitF  = server.arg("unit") == "f";
  if (server.hasArg("khz"))                  // live carrier tuning, e.g. ?khz=36
    carrierKhz = constrain(server.arg("khz").toInt(), 30, 60);

  String hex = sendAC(power, mode, temp, fan, swing, unitF);
  server.send(200, "text/plain",
              "sent  frame=" + hex + "  carrier=" + carrierKhz + "kHz\n");
}

void handleOff() {
  if (server.hasArg("khz"))
    carrierKhz = constrain(server.arg("khz").toInt(), 30, 60);
  String hex = sendAC(false, MODE_COOL, 23, FAN_AUTO, false, false);
  server.send(200, "text/plain",
              "off  frame=" + hex + "  carrier=" + carrierKhz + "kHz\n");
}

void handleRoot() {
  static const char PAGE[] = R"HTML(<!doctype html><html><head><meta charset=utf-8>
<meta name=viewport content="width=device-width,initial-scale=1">
<title>Sencor MT9020C</title>
<style>
 body{font-family:sans-serif;max-width:420px;margin:1.2rem auto;padding:0 1rem}
 label{display:block;margin:.5rem 0 .15rem;font-size:.8rem;color:#555}
 select,input{width:100%;padding:.45rem;font-size:1rem;box-sizing:border-box}
 .row{display:flex;gap:.6rem}.row>div{flex:1}
 button{margin-top:1rem;padding:.65rem 1rem;font-size:1rem;cursor:pointer}
 #out{margin-top:1rem;background:#111;color:#0f0;padding:.6rem;white-space:pre-wrap;
      font-family:monospace;font-size:.8rem;border-radius:4px}
</style></head><body>
<h3>Sencor MT9020C</h3>
<label>Mode</label>
<select id=mode><option>cool<option>heat<option>dry<option>fan<option>hold</select>
<div class=row>
 <div><label>Temp &deg;C</label><input id=temp type=number value=22 min=13 max=32></div>
 <div><label>Fan</label><select id=fan>
   <option>auto<option>sleep<option>low<option>med<option>high</select></div>
</div>
<div class=row>
 <div><label>Swing</label><select id=swing><option value=0>off<option value=1>on</select></div>
 <div><label>Unit</label><select id=unit><option value=c>&deg;C<option value=f>&deg;F</select></div>
 <div><label>Carrier kHz</label><input id=khz type=number value=38 min=30 max=60></div>
</div>
<button onclick=send()>Send / ON</button>
<button onclick=off()>OFF</button>
<pre id=out>ready</pre>
<script>
 var out=document.getElementById('out');
 function q(){return ['mode','temp','fan','swing','unit','khz'].map(function(id){
   return id+'='+encodeURIComponent(document.getElementById(id).value);}).join('&');}
 function go(u){out.textContent='...';fetch(u).then(function(r){return r.text();})
   .then(function(t){out.textContent=t;}).catch(function(e){out.textContent='ERR '+e;});}
 function send(){go('/ac?power=on&'+q());}
 function off(){go('/off?'+q());}
</script>
</body></html>)HTML";
  server.send(200, "text/html", PAGE);
}

// ---- Setup / loop --------------------------------------------------------
// WiFi status codes (for the log): 0 IDLE, 1 NO_SSID (wrong name / 5 GHz),
// 3 CONNECTED, 4 CONNECT_FAILED (wrong password), 6 DISCONNECTED.
void connectWiFi(uint32_t timeoutMs) {
  WiFi.begin(WIFI_SSID, WIFI_PASS);
  Serial.printf("Connecting to '%s'", WIFI_SSID);
  uint32_t t0 = millis();
  while (WiFi.status() != WL_CONNECTED && millis() - t0 < timeoutMs) {
    delay(300);
    Serial.print('.');
  }
  Serial.println();
}

void setup() {
  Serial.begin(115200);
  delay(300);                                   // let USB-serial settle
  Serial.println("\n[Sencor MT9020C IR bridge] booting");

  irSetup();
  rxSetup();

  WiFi.mode(WIFI_STA);
  WiFi.setAutoReconnect(true);
  Serial.printf("MAC: %s\n", WiFi.macAddress().c_str());

  connectWiFi(20000);                           // non-blocking with timeout
  if (WiFi.status() == WL_CONNECTED)
    Serial.printf("Ready: http://%s/\n", WiFi.localIP().toString().c_str());
  else
    Serial.printf("WiFi not connected (status=%d) — retrying in background.\n",
                  WiFi.status());

  server.on("/", handleRoot);
  server.on("/ac", handleAC);
  server.on("/off", handleOff);
  server.on("/rx", []() { server.send(200, "text/plain", "last RX: " + lastRx + "\n"); });
  server.begin();                               // server starts regardless
}

void loop() {
  static uint32_t lastTry = 0;
  if (WiFi.status() != WL_CONNECTED && millis() - lastTry > 10000) {
    lastTry = millis();
    connectWiFi(15000);
    if (WiFi.status() == WL_CONNECTED)
      Serial.printf("Ready: http://%s/\n", WiFi.localIP().toString().c_str());
  }
  if (rmtReceiveCompleted(IR_RX_PIN)) {           // a frame arrived → decode it
    decodeReceived(rxBuf, rxNum);
    rxStart();                                    // re-arm the receiver
  }
  server.handleClient();
}
